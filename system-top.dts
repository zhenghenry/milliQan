/*
 * CAUTION: This file is automatically generated by Xilinx.
 * Version:  
 * Today is: Tue Jul 17 11:26:20 2018
 */


/dts-v1/;
/include/ "zynq-7000.dtsi"
/include/ "pl.dtsi"
/include/ "pcw.dtsi"
/ {
	chosen {
		bootargs = "earlycon";
	};
	aliases {
		i2c0 = &axi_iic_0;
		i2c1 = &i2c0;
		i2c2 = &i2c1;
	};
	memory {
		device_type = "memory";
		reg = <0x0 0x20000000>;
	};
};
